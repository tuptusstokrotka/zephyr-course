## app/Kconfig
```kconfig
config APP_HEARTBEAT_PERIOD_MS
    int "Heartbeat period (100-2000)"
    default 500
    range 100 2000

menuconfig LED_SUBSYSTEM
    bool "LED Subsystem"
    default y

if LED_SUBSYSTEM
    choice
        prompt "LED blink sleep time"
        default BLINK_1000MS

        config BLINK_2000MS
            bool "Slow (2000 ms)"
        config BLINK_1000MS
            bool "Medium (1000 ms)"
        config BLINK_500MS
            bool "Fast (500 ms)"
        config BLINK_250MS
            bool "Fast (250 ms)"
    endchoice

    config BLINK_SLEEP_LIST_MS
        int # without prompt, only the value from the choice
        default 2000 if BLINK_2000MS
        default 1000 if BLINK_1000MS
        default 500 if BLINK_500MS
        default 250 if BLINK_250MS
        default 0

    menuconfig LED_ADVANCED_SETTINGS
        bool "Advanced LED settings"
        default n

        config LED_BRIGHTNESS
            int "LED Brightness (0-100)"
            default 100
            range 0 100

        config LED_FADE_DURATION
            int "LED Fade Duration (ms)"
            default 500

        menu "Expert settings"
            visible if LED_ADVANCED_SETTINGS

            config LED_DEBUG
                bool "Enable LED debugging"
                default n

            config CUSTOM_BLINK_PATTERN
                bool "Custom blink pattern"
                default n
        endmenu

endif # LED_SUBSYSTEM

source "Kconfig.zephyr"
rsource "drivers/our_driver/Kconfig"
```

## app/boards/our_board/Kconfig.our_board
```kconfig
# Copyright (c) 2017 Bobby Noelte
# SPDX-License-Identifier: Apache-2.0

config BOARD_OUR_BOARD
	select SOC_STM32F091XC
```

## dts/bindings/our,driver.yaml
```yaml
description: Simple driver for testing purposes
compatible: "our,driver"
include: base.yaml
properties:
  gpios:
    type: phandle-array
    required: true
  sleep-ms:
    type: int
    required: true
  blinking-on:
    type: boolean
    required: false
```
