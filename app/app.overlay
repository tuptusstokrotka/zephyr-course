/ {
    our_driver0: our_driver {
        compatible = "our,driver";
        gpios = <&gpioa 5 GPIO_ACTIVE_HIGH>;
        sleep-ms = <500>;
        blinking-on;                // Default state of the blinking is on
        status = "okay";
    };

    aliases {
        // onboard led
        app-led = "/leds/led_2";    // by path
        // app-led = &green_led_2;     // by node
    };
};